## boards/shields/klotz/Kconfig.defconfig
```kconfig
# Copyright (c) 2022 The ZMK Contributors
# SPDX-License-Identifier: MIT

if SHIELD_KLOTZ_LEFT

config ZMK_KEYBOARD_NAME
    default "KLOTZ"

config ZMK_SPLIT_ROLE_CENTRAL
    default y

endif # SHIELD_KLOTZ_LEFT

if SHIELD_KLOTZ_LEFT || SHIELD_KLOTZ_RIGHT

config ZMK_SPLIT
    default y

endif # SHIELD_KLOTZ_LEFT/_RIGHT

if ZMK_BACKLIGHT

    config PWM
        default y

    config LED_PWM
        default y

endif # ZMK_BACKLIGHT
```

## boards/shields/klotz/Kconfig.shield
```kconfig
# Copyright (c) 2022 The ZMK Contributors
# SPDX-License-Identifier: MIT

config SHIELD_KLOTZ_LEFT
    def_bool $(shields_list_contains,klotz_left)

config SHIELD_KLOTZ_RIGHT
    def_bool $(shields_list_contains,klotz_right)
```
